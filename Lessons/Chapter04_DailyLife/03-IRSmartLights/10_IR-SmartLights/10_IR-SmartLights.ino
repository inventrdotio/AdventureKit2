/*
 * Day 0 - AI Apocalypse by inventr.io
 * Learn more at https://inventr.io/PLACEHOLDER
 *
 * OK, I admit it.  With all the exhausting work we're doing I need my rest, and when managed
 * to crash into a piece of furniture trying to find my bed after turning off my room lights.
 *
 * I found this remote control in our stash that works with Infra-Red codes.  Apparently real
 * old video display devices once used this method to allow viewers to control their devices
 * instead of just looking at the device and speaking.
 *
 * But with no AI, this will work to turn my lights on and off from bed.  And while we're at it
 * we can use RGB colored LEDs to let me set the color I like (in case I want a nice night light).
 *
 * Our first step is to figure out what codes this IR remote control sends since there's no
 * documentation included.  Let's create a sketch that listens for IR commands and displays
 * them.  As we decode each command we can add a description for each that we can use later.
 *
 * Alex Eschenauer
 * David Schmidt
 */

#include "Arduino.h"
#include <IRremote.h>

/* Choosing what pin to use.
 * This project only needs digital pins.  So, on the Hero XL we *could* use any digital or analog pin
 * (D0-D53, A0-A15).  However, some pins support specialized functions and in later lessons we will be
 * using multiple parts, some of which will use some of those special functions.  So, let's start out
 * on the right foot by trying to use the most basic pin we can for each of our parts.
 *
 * Skip: A0-A15 (save for Analog),
 *       D0/D1 (used by USB and Serial)
 *       D14-D19 (used by Serial 1-3)
 *       D2/D3, D18-D21 (used for external interrupts)
 *       D13 (this pin controls the build in LED on the HERO XL board (LED_BUILTIN)),
 *       D2-D13, D44-D46 (used for Pulse Width Modulation (PWM))
 *       D50 (MISO), D51 (MOSI), D52 (SCK), D53 (SS).  (used for SPI communication)
 *       D20 (SDA), D21 (SCL).  (used for I2C communication using the Wire library)
 * Recommended for fewest conflicts:
 *    D22-D43, D47-D49, A8-A15
 */

const uint8_t IR_SIGNAL_PIN = 28;  // Signal Pin of IR receiver

// This structure allows us to display a description for each recognized command
struct CommandDescription {
  unsigned int command;     // command generated by IR remote button
  const char* description;  // button description
};

// Define a constant equal to our decoded command for each of our remote's buttons
enum IR_COMMANDS {
  POWER_BUTTON = 69,  // replace with actual command values
  BUTTON_0 = 0,
  BUTTON_1 = 0,
  BUTTON_2 = 0,
  BUTTON_3 = 0,
  BUTTON_4 = 0,
  BUTTON_5 = 0,
  BUTTON_6 = 0,
  BUTTON_7 = 0,
  BUTTON_8 = 0,
  BUTTON_9 = 0,
  VOLUME_UP_BUTTON = 0,
  VOLUME_DOWN_BUTTON = 0,
  FUNC_STOP = 0,
  REWIND = 0,
  PLAY_PAUSE = 0,
  FAST_FORWARD = 0,
  DOWN = 0,
  UP = 0,
  EQ = 0,
  ST_REPT = 0,
};

// Define what command each of our buttons generates.
const CommandDescription DESCRIPTIONS[] = {
  // Add more buttons and descriptions as we run the sketch and identify what commands go with each button
  { POWER_BUTTON, "Power button" },  // Add new buttons below this button
  { BUTTON_0, "0 button" },
  { BUTTON_1, "1 button" },
  { BUTTON_2, "2 button" },
  { BUTTON_3, "3 button" },
  { BUTTON_4, "4 button" },
  { BUTTON_5, "5 button" },
  { BUTTON_6, "6 button" },
  { BUTTON_7, "7 button" },
  { BUTTON_8, "8 button" },
  { BUTTON_9, "9 button" },
  { VOLUME_UP_BUTTON, "Volume Up button" },
  { VOLUME_DOWN_BUTTON, "Volume Down button" },
  { FUNC_STOP, "FUNC/STOP button" },
  { REWIND, "Rewind button" },
  { PLAY_PAUSE, "Play/Pause button" },
  { FAST_FORWARD, "Fast Forward button" },
  { DOWN, "Down button" },
  { UP, "Up button" },
  { EQ, "EQ button" },
  { ST_REPT, "ST/REPT button" }
};

const int DESCRIPTION_COUNT = sizeof(DESCRIPTIONS) / sizeof(CommandDescription);

// Initialize our IR Remote library code.
IRrecv receiver(IR_SIGNAL_PIN);

void setup() {
  Serial.begin(9600);
  receiver.enableIRIn();  // Start the IR receiver
}

void loop() {
  // Checks received an IR signal
  if (receiver.decode()) {
    unsigned int IRCommand = receiver.decodedIRData.command;
    displayIRCommand(IRCommand);
    receiver.resume();  // Receive the next value
  }
}

void displayIRCommand(unsigned int command) {
  for (int i = 0; i < DESCRIPTION_COUNT; i++) {
    if (DESCRIPTIONS[i].command == command) {
      Serial.println(String(DESCRIPTIONS[i].description) + "(" + String(int(command)) + ")");
      return;
    }
  }
  Serial.println("Unrecognized command: " + String(command));
}
