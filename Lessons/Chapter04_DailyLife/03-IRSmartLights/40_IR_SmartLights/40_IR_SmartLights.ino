/*
 * Day 0 - AI Apocalypse by inventr.io
 * Learn more at https://inventr.io/PLACEHOLDER
 *
 * Much better!  One last tweek.  With a bit more coding (and a bit of re-wiring) we can alter
 * the intensity of each color in smaller increments to let us get a lot more colors.
 * We *do* need to use Pulse Width Modulation to get partial power to each color, so we'll
 * be *moving* the pins used over to pins that support PWM (44-46).  (See the updated wiring diagram.)
 *
 * Alex Eschenauer
 * David Schmidt
 */

#include "Arduino.h"
#include <IRremote.h>

/* Choosing what pin to use.
 * This project only needs digital pins.  So, on the Hero XL we *could* use any digital or analog pin
 * (D0-D53, A0-A15).  However, some pins support specialized functions and in later lessons we will be
 * using multiple parts, some of which will use some of those special functions.  So, let's start out
 * on the right foot by trying to use the most basic pin we can for each of our parts.
 *
 * Skip: A0-A15 (save for Analog),
 *       D0/D1 (used by USB and Serial)
 *       D14-D19 (used by Serial 1-3)
 *       D2/D3, D18-D21 (used for external interrupts)
 *       D13 (this pin controls the build in LED on the HERO XL board (LED_BUILTIN)),
 *       D2-D13, D44-D46 (used for Pulse Width Modulation (PWM))
 *       D50 (MISO), D51 (MOSI), D52 (SCK), D53 (SS).  (used for SPI communication)
 *       D20 (SDA), D21 (SCL).  (used for I2C communication using the Wire library)
 * Recommended for fewest conflicts:
 *    D22-D43, D47-D49, A8-A15
 */

const uint8_t IR_SIGNAL_PIN = 28;  // Signal Pin of IR receiver

// RGB LED control pins
const uint8_t RED_PIN = 44;
const uint8_t GREEN_PIN = 45;
const uint8_t BLUE_PIN = 46;

// Remap HIGH/LOW to ON/OFF for code readability
const uint8_t ON = 255;
const uint8_t OFF = LOW;

// This structure allows us to display a description for each recognized command
struct RemoteButton {
  unsigned int command;     // command generated by IR remote button
  const char* description;  // button description
};

// Define a constant equal to our decoded command for each of our remote's buttons
enum IR_COMMANDS {
  POWER_BUTTON = 69,
  BUTTON_0 = 22,
  BUTTON_1 = 12,
  BUTTON_2 = 24,
  BUTTON_3 = 94,
  BUTTON_4 = 8,
  BUTTON_5 = 28,
  BUTTON_6 = 90,
  BUTTON_7 = 66,
  BUTTON_8 = 82,
  BUTTON_9 = 74,
  VOLUME_UP_BUTTON = 70,
  VOLUME_DOWN_BUTTON = 21,
  FUNC_STOP = 71,
  REWIND = 68,
  PLAY_PAUSE = 64,
  FAST_FORWARD = 67,
  DOWN = 7,
  UP = 9,
  EQ = 25,
  ST_REPT = 13,
};

// Define what command each of our buttons generates.
const RemoteButton BUTTONS[] = {
  // Add more buttons and descriptions as we run the sketch and identify what commands go with each button
  { POWER_BUTTON, "Power button" },  // Add new buttons below this button
  { BUTTON_1, "Toggle Red" },
  { BUTTON_2, "Decrease Red"},
  { BUTTON_3, "Increase Red"},
  { BUTTON_4, "Toggle Green" },
  { BUTTON_5, "Decrease Green"},
  { BUTTON_6, "Increase Green"},
  { BUTTON_7, "Toggle Blue" },
  { BUTTON_8, "Decrease Blue"},
  { BUTTON_9, "Increase Blue"},  // comma isn't required on last entry, but it doesn't hurt and makes insertions easier
};

const int BUTTON_COUNT = sizeof(BUTTONS) / sizeof(RemoteButton);

const uint8_t INCREMENT = 256 / 4;  // gives us 4 different intensities per color

// declare non-void function (which is implemented below)
uint8_t changeColor(uint8_t currentIntensity, int increment = INCREMENT);

// Initialize our IR Remote library code.
IRrecv receiver(IR_SIGNAL_PIN);

void setup() {
  Serial.begin(9600);
  receiver.enableIRIn();  // Start the receiver

  // LED pins are all outputs
  pinMode(RED_PIN, OUTPUT);
  pinMode(GREEN_PIN, OUTPUT);
  pinMode(BLUE_PIN, OUTPUT);
}

// Track whether light is powered on or off, and last status of each color
uint8_t light_is_on = false;
uint8_t red_last_value = 0;
uint8_t green_last_value = 0;
uint8_t blue_last_value = 0;

void loop() {
  // Checks received an IR signal
  if (receiver.decode()) {
    unsigned int IRCommand = receiver.decodedIRData.command;
    displayIRCommand(IRCommand);

    if (IRCommand == POWER_BUTTON) {
      if (light_is_on) {  // light is on, turn off
        Serial.println("turn off");
        setColor(OFF, OFF, OFF);
        light_is_on = false;
      } else {
        Serial.println("turn on");
        // If all LEDs were off, blink light twice to let user know it's enabled
        if (red_last_value == 0 && green_last_value == 0 && blue_last_value == 0) {
          blinkLight();  // blink light twice to let user know it's ready for color commands
        } else {         // otherwise, turn light on with previous color
          setColor(red_last_value, green_last_value, blue_last_value);
        }
        light_is_on = true;
      }
    }

    if (light_is_on) {
      switch (IRCommand) {
        case BUTTON_1:  // Toggle red LED
          if (red_last_value == 0) {
            digitalWrite(RED_PIN, ON);
            red_last_value = 255;
          } else {
            digitalWrite(RED_PIN, OFF);
            red_last_value = 0;
          }
          break;
        case BUTTON_2:  // Decrease red intensity
          red_last_value = changeColor(red_last_value, -INCREMENT);
          Serial.println("Red value is " + String(red_last_value));
          analogWrite(RED_PIN, red_last_value);
          break;
        case BUTTON_3:  // Increase red intensity
          red_last_value = changeColor(red_last_value);
          Serial.println("Red value is " + String(red_last_value));
          analogWrite(RED_PIN, red_last_value);
          break;
        case BUTTON_4:  // Toggle green LED
          if (green_last_value == OFF) {
            digitalWrite(GREEN_PIN, ON);
            green_last_value = ON;
          } else {
            digitalWrite(GREEN_PIN, OFF);
            green_last_value = OFF;
          }
          break;
        case BUTTON_5:  // Decrease green intensity
          green_last_value = changeColor(green_last_value, -INCREMENT);
          Serial.println("Green value is " + String(green_last_value));
          analogWrite(GREEN_PIN, green_last_value);
          break;
        case BUTTON_6:  // Increase green intensity
          green_last_value = changeColor(green_last_value);
          Serial.println("Green value is " + String(green_last_value));
          analogWrite(GREEN_PIN, green_last_value);
          break;
        case BUTTON_7:  // Toggle blue LED
          if (blue_last_value == OFF) {
            digitalWrite(BLUE_PIN, ON);
            blue_last_value = ON;
          } else {
            digitalWrite(BLUE_PIN, OFF);
            blue_last_value = OFF;
          }
          break;
        case BUTTON_8:  // Decrease blue intensity
          blue_last_value = changeColor(blue_last_value, -INCREMENT);
          Serial.println("Blue value is " + String(red_last_value));
          analogWrite(BLUE_PIN, blue_last_value);
          break;
        case BUTTON_9:  // Increase blue intensity
          blue_last_value = changeColor(blue_last_value);
          Serial.println("Blue value is " + String(blue_last_value));
          analogWrite(BLUE_PIN, blue_last_value);
          break;
      }
    }
    delay(50);          // Delay to skip double presses
    receiver.resume();  // Receive the next value
  }
}

void displayIRCommand(unsigned int command) {
  for (int i = 0; i < BUTTON_COUNT; i++) {
    if (BUTTONS[i].command == command) {
      Serial.println(String(BUTTONS[i].description) + "(" + String(int(command)) + ")");
      return;
    }
  }
  Serial.println("Unrecognized command: " + String(command));
}

void setColor(int redValue, int greenValue, int blueValue) {
  analogWrite(RED_PIN, redValue);
  analogWrite(GREEN_PIN, greenValue);
  analogWrite(BLUE_PIN, blueValue);
}

void blinkLight() {
  setColor(ON, ON, ON);  // Light on
  delay(500);
  setColor(OFF, OFF, OFF);  // Light off
  delay(500);
  setColor(ON, ON, ON);  // Light on
  delay(500);
  setColor(OFF, OFF, OFF);  // Light off
}

// Increase the intensity of our color value in steps. Since our PWM values go from 0-255
// we will add the increment (which might be negative for turning color down) and then 
// adjust the value so that it remains inside the 0-255 range.
uint8_t changeColor(uint8_t currentIntensity, int increment = INCREMENT) {
  int new_value = currentIntensity + increment;   // because this is done as an int it can go outside 0-255
  Serial.println("Current = " + String(currentIntensity));
  Serial.println("Increment: " + String(increment));
  if (new_value > 255) {
    new_value = 255;
  }
  if (new_value < 0) {
    new_value = 0;
  }
  Serial.println("New = " + String(new_value));
  return (uint8_t) new_value;
}
